## oe-recipes/conf/layer.conf
```bitbake
BBPATH .= ":${LAYERDIR}"
BBFILES += "${LAYERDIR}/recipes-*/*/*.bb ${LAYERDIR}/recipes-*/*/*.bbappend"
BBFILE_COLLECTIONS += "onekvm-extension-wireguard"
BBFILE_PATTERN_onekvm-extension-wireguard := "^${LAYERDIR}/"
BBFILE_PRIORITY_onekvm-extension-wireguard = "8"
LAYERDEPENDS_onekvm-extension-wireguard = "core onekvm"
LAYERSERIES_COMPAT_onekvm-extension-wireguard = "wrynose"
```
